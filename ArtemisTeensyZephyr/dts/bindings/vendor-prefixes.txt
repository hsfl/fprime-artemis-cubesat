## fprime-artemis-core/dts/bindings/misc/artemis,rpi-power.yaml
```yaml
description: Artemis CubeSat kit RPi power control pin
compatible: "artemis,rpi-power"
properties:
  rpi-enable-gpios:
    type: phandle-array
    required: true
```

## fprime-artemis-core/dts/bindings/radio/artemis,rfm23bp.yaml
```yaml
description: Artemis RFM23BP radio module with external PA control
compatible: "artemis,rfm23bp"
include: spi-device.yaml
properties:
  irq-gpios:
    type: phandle-array
    required: true
  rx-on-gpios:
    type: phandle-array
    required: true
  tx-on-gpios:
    type: phandle-array
    required: true
  sdn-gpios:
    type: phandle-array
    required: true
```

## fprime-artemis-core/dts/bindings/sensor/artemis,lsm6dsox-emul.yaml
```yaml
description: Local-twin LSM6DSOX register model
compatible: "artemis,lsm6dsox-emul"
include: i2c-device.yaml
```
